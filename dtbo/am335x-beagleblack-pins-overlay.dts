/dts-v1/;
/plugin/;
/ {
    compatible = "ti,beaglebone", "ti,beaglebone-black";
    part-number = "PRU-stopwatch-pin-config";
    version = "00A0";

    // Resources used by the overlay
    exclusive-use = "P9.27", "P9.28";

    // The PRU pin modes
    pru_pru_pins: pinmux_pru_pru_pins {
        pinctrl-single,pins = <
            0x1a4 0x05 // P9_27 / pr1_pru0_pru_r30_5 - Mode 5 output pull‐down
            0x19c 0x26 // P9_28 / pr1_pru0_pru_r31_3 - Mode 6 input  pull‐down
        >;
    };

    // Enable the GPIOs
    fragment@0 {
        target = <&ocp>;
        __overlay__ {
            gpio_helper {
                compatible = "gpio-of-helper";
                status = "okay";
                pinctrl-names = "default";
                pinctrl-0 = <&gpio_pins>;
            };
        };
    };
};
