/dts-v1/;
/plugin/;
/ {
    compatible = "ti,beaglebone", "ti,beaglebone-black";
    part-number = "AM335X-PRU-STOPWATCH";
    version = "00A0";
    exclusive-use = "P8.11", "P8.15", "P8.28", "P8.29";
    fragment@0 {
        target = <&pruss>;
        __overlay__ {
            pinctrl-names = "default";
            pinctrl-0 = <&pinmux_P8_11_pruout_pin>;
            pinctrl-1 = <&pinmux_P8_15_pruin_pin>;
            pinctrl-2 = <&pinmux_P8_28_pruout_pin>;
            pinctrl-3 = <&pinmux_P8_29_pruin_pin>;
            status = "okay";
        };
    };
};
